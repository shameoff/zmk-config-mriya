## boards/shields/mriya/Kconfig.defconfig
```kconfig
if SHIELD_MRIYA_LEFT

config ZMK_KEYBOARD_NAME
	default "Mriya"

config ZMK_SPLIT_BLE_ROLE_CENTRAL
	default y

endif # SHIELD_MRIYA_LEFT

if SHIELD_MRIYA_LEFT || SHIELD_MRIYA_RIGHT

config ZMK_SPLIT
 	default y

endif # SHIELD_MRIYA_LEFT || SHIELD_MRIYA_RIGHT
```

## boards/shields/mriya/Kconfig.shield
```kconfig
# No whitespace after the comma or in your part name!
config SHIELD_MRIYA_LEFT
    def_bool $(shields_list_contains,mriya_left)

config SHIELD_MRIYA_RIGHT
    def_bool $(shields_list_contains,mriya_right)
```
